## firmware/experiments/audio_bench/main/Kconfig.projbuild
```kconfig
menu "RoadWeave audio bench"

    config RW_I2S_BCLK_GPIO
        int "I2S BCLK GPIO (mic + amp shared)"
        default 42
        help
            Issue #18 draft: D11 / GPIO42 (bottom pad). Any free GPIO works on the bench.

    config RW_I2S_WS_GPIO
        int "I2S WS/LRCLK GPIO (mic + amp shared)"
        default 41
        help
            Issue #18 draft: D12 / GPIO41 (bottom pad).

    config RW_I2S_MIC_DIN_GPIO
        int "I2S mic DOUT -> ESP32 DIN GPIO"
        default 6
        help
            Issue #18 draft: D5 / GPIO6.

    config RW_I2S_SPK_DOUT_GPIO
        int "I2S amp DIN <- ESP32 DOUT GPIO"
        default 43
        help
            Issue #18 draft: D6 / GPIO43. Set to -1 when no amp is connected (capture only).

    config RW_PTT_GPIO
        int "PTT switch GPIO (active low, internal pull-up)"
        default 44
        help
            Issue #18 draft: D7 / GPIO44. Set to -1 to disable PTT (never mute).

    config RW_AMP_SD_GPIO
        int "Amp SD/shutdown GPIO (high = enabled), -1 if tied on the breakout"
        default -1

    config RW_LOOPBACK
        bool "Play mic input back through the amp (Issue #4 loopback)"
        default y

    config RW_TEST_TONE
        bool "Play a 1 kHz test tone instead of the mic (amp/speaker check)"
        default n

    config RW_OUTPUT_GAIN_PERCENT
        int "Output gain percent (100 = unity)"
        range 0 400
        default 50

endmenu
```

## firmware/experiments/halow_link/main/Kconfig.projbuild
```kconfig
menu "RoadWeave HaLow link test"
choice RW_LINK_ROLE
    prompt "Device role"
    default RW_LINK_AP
config RW_LINK_AP
    bool "AP / UDP echo server"
config RW_LINK_STA
    bool "STA / UDP probe client"
endchoice
config RW_LINK_RF_ENABLE
    bool "Run radio connection test (requires prepared RF test setup)"
    default n
    help
        Disabled: inspect SPI and embedded FW/BCF files only; never boot radio firmware.
        Enabled: starts AP beacons or STA association and transmits UDP packets.
        WM6180 RF port must have a suitable load and the test setup must permit RF operation.
config RW_LINK_SSID
    string "Test SSID"
    default "RoadWeaveBench"
config RW_LINK_PSK
    string "Test WPA3 passphrase (keep local)"
    default ""
config RW_LINK_CHANNEL
    int "AP S1G channel (0 means not configured)"
    range 0 255
    default 0
config RW_LINK_OPCLASS
    int "AP operating class (0 means not configured)"
    range 0 255
    default 0
config RW_LINK_TX_POWER_DBM
    int "Maximum transmit power override (dBm; 0 disables override in SDK)"
    range 1 13
    default 1
config RW_LINK_CONTINUOUS
    bool "Finite continuous UDP validation (legacy 20 probes when disabled)"
    default n
    depends on RW_LINK_RF_ENABLE
config RW_LINK_THROUGHPUT
    bool "Serial-controlled finite one-way UDP throughput stages"
    default n
    depends on RW_LINK_CONTINUOUS
    help
        Opt-in replacement for the continuous echo workload. AP and STA can
        each receive or send bounded, independently commanded UDP stages.
config RW_TPUT_SESSION_SECONDS
    int "Maximum throughput command-session duration in seconds"
    range 60 3600
    default 1800
    depends on RW_LINK_THROUGHPUT
config RW_LINK_DHCP
    bool "Use AP DHCP server and STA DHCP client in continuous mode"
    default n
    depends on RW_LINK_CONTINUOUS
config RW_LINK_RUN_SECONDS
    int "Continuous run duration in seconds"
    range 30 28800
    default 180
    depends on RW_LINK_CONTINUOUS
config RW_LINK_MAX_PROBES
    int "STA maximum probes (0 uses duration only)"
    range 0 100000
    default 0
    depends on RW_LINK_CONTINUOUS && RW_LINK_STA
config RW_LINK_PAYLOAD_BYTES
    int "Continuous UDP datagram length in bytes"
    range 32 1024
    default 256
    depends on RW_LINK_CONTINUOUS
config RW_LINK_INTERVAL_MS
    int "Continuous STA probe interval in milliseconds"
    range 100 5000
    default 250
    depends on RW_LINK_CONTINUOUS && RW_LINK_STA
config RW_LINK_STA_ID
    int "STA ID (1 => 192.168.50.2, 2 => 192.168.50.3)"
    range 1 2
    default 1
    depends on RW_LINK_STA
endmenu
```

## firmware/experiments/ui_lvgl/main/Kconfig.projbuild
```kconfig
menu "RoadWeave UI (2.8in ILI9341 + XPT2046)"
    config RW_LCD_SCLK_GPIO
        int "LCD SPI SCLK"
        default 7
    config RW_LCD_MOSI_GPIO
        int "LCD SPI MOSI"
        default 9
    config RW_LCD_MISO_GPIO
        int "LCD/touch SPI MISO (-1 if unused)"
        default 8
    config RW_LCD_CS_GPIO
        int "LCD CS"
        default 4
    config RW_LCD_DC_GPIO
        int "LCD DC"
        default 3
    config RW_LCD_RST_GPIO
        int "LCD RESET (-1 = not wired)"
        default 2
    config RW_LCD_BL_GPIO
        int "LCD backlight (PWM, -1 = always on)"
        default 1
    config RW_TOUCH_CS_GPIO
        int "XPT2046 touch CS (-1 = no touch)"
        default 5
    config RW_TOUCH_IRQ_GPIO
        int "XPT2046 touch IRQ (-1 = polling)"
        default -1
    config RW_LCD_SPI_MHZ
        int "LCD SPI clock MHz"
        range 10 80
        default 40
    config RW_UI_SIMULATE
        bool "Drive the UI from simulated convoy/voice data (no radio/GPS needed)"
        default y
endmenu
```

## firmware/experiments/ui_lvgl/sdkconfig.defaults
```kconfig
CONFIG_ESP_CONSOLE_USB_SERIAL_JTAG=y
CONFIG_ESP_CONSOLE_SECONDARY_NONE=y
CONFIG_ESPTOOLPY_FLASHMODE_QIO=y
CONFIG_ESPTOOLPY_FLASHSIZE_8MB=y
CONFIG_SPIRAM=y
CONFIG_SPIRAM_MODE_OCT=y
CONFIG_SPIRAM_SPEED_80M=y
CONFIG_ESP_DEFAULT_CPU_FREQ_MHZ_240=y
CONFIG_COMPILER_OPTIMIZATION_PERF=y
CONFIG_LV_COLOR_DEPTH_16=y
CONFIG_LV_FONT_MONTSERRAT_14=y
CONFIG_LV_FONT_MONTSERRAT_20=y
CONFIG_LV_FONT_MONTSERRAT_28=y
CONFIG_LV_USE_FONT_COMPRESSED=y
```

## firmware/experiments/voice_udp/main/Kconfig.projbuild
```kconfig
menu "RoadWeave voice_udp"

    config RW_WIFI_SSID
        string "Wi-Fi SSID (2.4 GHz stand-in for HaLow; not committed, lives in sdkconfig)"
        default ""
    config RW_WIFI_PASS
        string "Wi-Fi password"
        default ""
    config RW_PEER_IP
        string "Peer IPv4 (the Mac running tools/rwp_peer.py)"
        default "192.168.1.10"
    config RW_UDP_PORT
        int "UDP port (send and listen)"
        default 5004
    config RW_GROUP_ID
        hex "Group ID"
        default 0x00000001
    config RW_SENDER_ID
        hex "Sender (node) ID"
        default 0x00000101

    config RW_COORDINATOR
        bool "This node is the Group Coordinator (floor control). Exactly one node per group; also true for the Mac-echo bench"
        default y
    config RW_COORD_IP
        string "Coordinator IPv4 (used when this node is not the coordinator)"
        default "192.168.1.11"
    config RW_GROUP_BROADCAST
        bool "Send voice to the IPv4 broadcast address instead of the peer (2+ nodes on one AP)"
        default n

    config RW_TX_ALWAYS
        bool "Hold PTT virtually forever (bench measurement without a switch)"
        default y
    config RW_PLAY_ECHO
        bool "Play back frames whose sender_id is ours (echo from peer) - hear your own mouth-to-ear latency"
        default y

    config RW_I2S_BCLK_GPIO
        int "I2S BCLK GPIO"
        default 42
    config RW_I2S_WS_GPIO
        int "I2S WS GPIO"
        default 41
    config RW_I2S_MIC_DIN_GPIO
        int "I2S mic DIN GPIO"
        default 6
    config RW_I2S_SPK_DOUT_GPIO
        int "I2S amp DOUT GPIO (-1 = no amp)"
        default 43
    config RW_PTT_GPIO
        int "PTT GPIO (active low, -1 = none)"
        default 44
    config RW_AMP_SD_GPIO
        int "Amp SD GPIO (-1 = tied)"
        default -1
    config RW_OUTPUT_GAIN_PERCENT
        int "Output gain percent"
        range 0 400
        default 50
endmenu
```
